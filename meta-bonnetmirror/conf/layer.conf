## meta-bonnetmirror/conf/layer.conf
```bitbake
# We have a conf and classes directory, add to BBPATH
BBPATH .= ":${LAYERDIR}"

# We have recipes-* directories, add to BBFILES
BBFILES += "${LAYERDIR}/recipes-*/*/*.bb \
            ${LAYERDIR}/recipes-*/*/*.bbappend"

BBFILE_COLLECTIONS += "meta-bonnetmirror"
BBFILE_PATTERN_meta-bonnetmirror = "^${LAYERDIR}/"
BBFILE_PRIORITY_meta-bonnetmirror = "6"

LAYERDEPENDS_meta-bonnetmirror = "core"
LAYERSERIES_COMPAT_meta-bonnetmirror = "scarthgap"
```
